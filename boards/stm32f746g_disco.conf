## boards/stm32f746g_disco.conf
```kconfig
# Copyright 2021 IOTA Stiftung
# SPDX-License-Identifier: Apache-2.0

# main stack
CONFIG_MAIN_STACK_SIZE=5120
CONFIG_NET_MGMT_EVENT_STACK_SIZE=2560
# newlibc instead of mini-libc
CONFIG_NEWLIB_LIBC=y
# use full version of Newlib
CONFIG_NEWLIB_LIBC_NANO=n

# this dev board dosen't have HW random generator
CONFIG_TEST_RANDOM_GENERATOR=y

# DHCPv4
CONFIG_NET_DHCPV4=y
CONFIG_DNS_RESOLVER=y
```

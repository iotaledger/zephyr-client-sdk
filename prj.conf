## CMakeLists.txt
```
#[[
// Copyright 2021 IOTA Stiftung
// SPDX-License-Identifier: Apache-2.0
]]

cmake_minimum_required(VERSION 3.13.1)

find_package(Zephyr REQUIRED HINTS $ENV{ZEPHYR_BASE})
project(iota_app)

# the directory of external libraries
set(EXT_LIB_DIR "${CMAKE_CURRENT_SOURCE_DIR}/libs")

set(EXT_LIB_SRC
    "${EXT_LIB_DIR}/cjson/cJSON.c" "${EXT_LIB_DIR}/blake2/blake2b-ref.c"
    "${EXT_LIB_DIR}/ed25519-donna/ed25519.c"
    "${EXT_LIB_DIR}/utf8proc/utf8proc.c")

set(EXT_LIB_INC
    "${EXT_LIB_DIR}/cjson" "${EXT_LIB_DIR}/blake2"
    "${EXT_LIB_DIR}/ed25519-donna" "${EXT_LIB_DIR}/uthash"
    "${EXT_LIB_DIR}/utf8proc")

# the directory of iota client source
set(IOTA_SRC_DIR "${CMAKE_CURRENT_SOURCE_DIR}/libs/iota-c/src")

# iota crypto implementation
set(IOTA_CRYPTO "${IOTA_SRC_DIR}/crypto/iota_crypto.c")

# iota protocol implementation
set(IOTA_CORE
    "${IOTA_SRC_DIR}/core/address.c"
    "${IOTA_SRC_DIR}/core/seed.c"
    "${IOTA_SRC_DIR}/core/models/inputs/utxo_input.c"
    "${IOTA_SRC_DIR}/core/models/outputs/outputs.c"
    "${IOTA_SRC_DIR}/core/models/payloads/indexation.c"
    "${IOTA_SRC_DIR}/core/models/payloads/transaction.c"
    "${IOTA_SRC_DIR}/core/models/message.c"
    "${IOTA_SRC_DIR}/core/models/unlock_block.c"
    "${IOTA_SRC_DIR}/core/utils/bech32.c"
    "${IOTA_SRC_DIR}/core/utils/byte_buffer.c"
    "${IOTA_SRC_DIR}/core/utils/iota_str.c"
    "${IOTA_SRC_DIR}/core/utils/slip10.c")

# iota client API implementation
set(IOTA_CLIENT
    "${IOTA_SRC_DIR}/client/network/http_zephyr.c"
    "${IOTA_SRC_DIR}/client/api/json_utils.c"
    "${IOTA_SRC_DIR}/client/api/message_builder.c"
    "${IOTA_SRC_DIR}/client/api/message.c"
    "${IOTA_SRC_DIR}/client/api/v1/find_message.c"
    "${IOTA_SRC_DIR}/client/api/v1/get_balance.c"
    "${IOTA_SRC_DIR}/client/api/v1/get_health.c"
    "${IOTA_SRC_DIR}/client/api/v1/get_message_children.c"
    "${IOTA_SRC_DIR}/client/api/v1/get_message_metadata.c"
    "${IOTA_SRC_DIR}/client/api/v1/get_message.c"
    "${IOTA_SRC_DIR}/client/api/v1/get_node_info.c"
    "${IOTA_SRC_DIR}/client/api/v1/get_output.c"
    "${IOTA_SRC_DIR}/client/api/v1/get_outputs_from_address.c"
    "${IOTA_SRC_DIR}/client/api/v1/get_tips.c"
    "${IOTA_SRC_DIR}/client/api/v1/response_error.c"
    "${IOTA_SRC_DIR}/client/api/v1/send_message.c")

# simple wallet reference
set(IOTA_WALLET "${IOTA_SRC_DIR}/wallet/wallet.c"
                "${IOTA_SRC_DIR}/wallet/bip39.c")

if(CONFIG_ZTEST)
  message("Unit tests is enabled")
  # unit test application, testing iota protocol only
  target_sources(
    app PRIVATE "tests/test_main.c" ${EXT_LIB_SRC} ${IOTA_CRYPTO} ${IOTA_CORE}
                "${IOTA_SRC_DIR}/client/network/http_zephyr.c")

else()
  # add TLS certification
  set(gen_dir ${ZEPHYR_BINARY_DIR}/include/generated/)
  generate_inc_file_for_target(app "src/app-cert.der"
                               "${gen_dir}/app-cert.der.inc")

  # build a full application
  target_sources(
    app
    PRIVATE "src/main.c"
            "src/iota_shell.c"
            "src/wifi.c"
            ${EXT_LIB_SRC}
            ${IOTA_CRYPTO}
            ${IOTA_CORE}
            ${IOTA_CLIENT}
            ${IOTA_WALLET})
endif()

# configure iota client lib
target_compile_definitions(
  app
  # crypto use mbedtls, ed25519-donna, blake2b ref
  PRIVATE CRYPTO_USE_MBEDTLS
  PRIVATE CRYPTO_USE_ED25519_DONNA
  PRIVATE CRYPTO_USE_BLAKE2B_REF
  # ed25519-donna config
  PRIVATE ED25519_CUSTOMRANDOM
  PRIVATE ED25519_CUSTOMHASH
  # Support English mnemonic only
  PRIVATE BIP39_ENGLISH_ONLY)

if(CONFIG_ZTEST)
  target_include_directories(app PUBLIC ${EXT_LIB_INC} ${IOTA_SRC_DIR}
                                        ${CMAKE_CURRENT_SOURCE_DIR}/tests)
else()
  target_include_directories(app PUBLIC ${EXT_LIB_INC} ${IOTA_SRC_DIR}
                                        ${CMAKE_SOURCE_DIR}/src)
endif()
```

## Kconfig
```
# Copyright 2021 IOTA Stiftung
# SPDX-License-Identifier: Apache-2.0

menu "IOTA SDK Config"

config IOTA_NODE_URL
	string "IOTA Node URL"
	default "https://chrysalis-nodes.iota.org/"

config IOTA_NODE_PORT
	int "The prot number to connect"
	range 0 65535
	default 443

config IOTA_HTTP_RECV_BUFF_SIZE
	int "HTTP Client receive buffer size"
	default 1024

module = IOTA_HTTP_CLIENT
module-str = IOTA HTTP Client
module-help = Enables logging for http client.
source "subsys/logging/Kconfig.template.log_config"

if WIFI

config APP_WIFI_AUTO
	bool "Setup WiFi"

config APP_WIFI_SSID
	string "WiFi SSID"
	depends on APP_WIFI_AUTO
	default "my_ssid"

config APP_WIFI_PWD
	string "WiFi Password(PSK)"
	depends on APP_WIFI_AUTO
	default "my_pwd"

if APP_WIFI_AUTO
module = APP_WIFI_CONN
module-str = WIFI Connection
module-help = Enables logging for WiFi connection.
source "subsys/logging/Kconfig.template.log_config"
endif # APP_WIFI_AUTO

endif # WIFI

config WALLET_MNEMONIC
	string "Wallet MNEMONIC"
	default "RANDOM"
	help
	The mnemonic sentence of this wallet

module = IOTA_APP
module-str = Application
module-help = Enables logging for IOTA Client application.
source "subsys/logging/Kconfig.template.log_config"
endmenu

source "Kconfig.zephyr"
```

## prj.conf
```kconfig
# Copyright 2021 IOTA Stiftung
# SPDX-License-Identifier: Apache-2.0

CONFIG_LOG=y
CONFIG_LOG_MODE_IMMEDIATE=y

# http client debugging
CONFIG_NET_LOG=y
# CONFIG_NET_HTTP_LOG_LEVEL_DBG=y
# CONFIG_IOTA_HTTP_CLIENT_LOG_LEVEL_DBG=y

# network & wifi
CONFIG_NETWORKING=y
CONFIG_NET_IPV4=y
CONFIG_NET_IPV6=n
CONFIG_NET_TCP=y
CONFIG_NET_SOCKETS=y
CONFIG_NET_SOCKETS_POSIX_NAMES=y
CONFIG_NET_TCP_TIME_WAIT_DELAY=2500

# network events
CONFIG_NET_MGMT=y
CONFIG_NET_MGMT_EVENT=y

# mbedtsl crypto
CONFIG_MBEDTLS=y
CONFIG_MBEDTLS_MAC_SHA512_ENABLED=y
CONFIG_MBEDTLS_PKCS5_C=y

# http client
CONFIG_HTTP_CLIENT=y

# shell
CONFIG_SHELL=y
CONFIG_NET_SHELL=y
# increase shell stack and cmd buffer for cli application
CONFIG_SHELL_STACK_SIZE=5120
CONFIG_SHELL_CMD_BUFF_SIZE=512
CONFIG_SHELL_DEFAULT_TERMINAL_WIDTH=120
```

## prj_native.conf
```kconfig
# Copyright 2021 IOTA Stiftung
# SPDX-License-Identifier: Apache-2.0

# CONFIG_LOG=y
# mbedtls for crypto and network
CONFIG_MBEDTLS=y
CONFIG_MBEDTLS_MAC_SHA512_ENABLED=y
# For test only
CONFIG_TEST_RANDOM_GENERATOR=y
# shell
CONFIG_SHELL=y
```

## prj_native_test.conf
```kconfig
# Copyright 2021 IOTA Stiftung
# SPDX-License-Identifier: Apache-2.0

CONFIG_ZTEST=y
CONFIG_ZTEST_STACKSIZE=10240
# CONFIG_LOG=y
# mbedtls for crypto and network
CONFIG_MBEDTLS=y
CONFIG_MBEDTLS_MAC_SHA512_ENABLED=y
# For test only
CONFIG_TEST_RANDOM_GENERATOR=y
```

## prj_test.conf
```kconfig
# Copyright 2021 IOTA Stiftung
# SPDX-License-Identifier: Apache-2.0

CONFIG_ZTEST=y
CONFIG_ZTEST_STACKSIZE=10240
# newlibc instead of mini-libc
CONFIG_NEWLIB_LIBC=y
# use full version of Newlib
CONFIG_NEWLIB_LIBC_NANO=n
# CONFIG_LOG=y
# mbedtls for crypto and network
CONFIG_MBEDTLS=y
CONFIG_MBEDTLS_MAC_SHA512_ENABLED=y
# enable hardware entropy driver
CONFIG_ENTROPY_GENERATOR=y
# use entropy driver to generate random numbers
CONFIG_ENTROPY_DEVICE_RANDOM_GENERATOR=y
# enable cryptographically secure random generator
CONFIG_HARDWARE_DEVICE_CS_GENERATOR=y
```

## boards/b_l4s5i_iot01a.conf
```kconfig
# Copyright 2021 IOTA Stiftung
# SPDX-License-Identifier: Apache-2.0

# main stack
# CONFIG_MAIN_STACK_SIZE=5120
# newlibc instead of mini-libc
CONFIG_NEWLIB_LIBC=y
# use full version of Newlib
CONFIG_NEWLIB_LIBC_NANO=n
CONFIG_NEWLIB_LIBC_FLOAT_PRINTF=y

# wifi
CONFIG_WIFI=y
CONFIG_NET_L2_WIFI_SHELL=y

# mbedtls TLS socket
CONFIG_NET_SOCKETS_SOCKOPT_TLS=y

# enable hardware entropy driver
CONFIG_ENTROPY_GENERATOR=y
# use entropy driver to generate random numbers
CONFIG_ENTROPY_DEVICE_RANDOM_GENERATOR=y
# enable cryptographically secure random generator
CONFIG_HARDWARE_DEVICE_CS_GENERATOR=y
```

## boards/native_posix.conf
```kconfig
# Copyright 2021 IOTA Stiftung
# SPDX-License-Identifier: Apache-2.0

# this dev board dosen't have HW random generator
CONFIG_TEST_RANDOM_GENERATOR=y
```

## boards/nrf9160dk_nrf9160.conf
```kconfig
# Copyright 2021 IOTA Stiftung
# SPDX-License-Identifier: Apache-2.0

# use full version of Newlib
CONFIG_NEWLIB_LIBC=y
CONFIG_NEWLIB_LIBC_NANO=n
```

## boards/b_l4s5i_iot01a.overlay
```dts
/*
 * Copyright 2021 IOTA Stiftung
 * SPDX-License-Identifier: Apache-2.0
*/

&spi3 {
	cs-gpios = <&gpiod 13 GPIO_ACTIVE_LOW>,
		   <&gpioe 0 GPIO_ACTIVE_LOW>;
};
```

## src/main.c
```c
// Copyright 2021 IOTA Stiftung
// SPDX-License-Identifier: Apache-2.0

#include <net/net_mgmt.h>
#include <stdio.h>
#include <zephyr.h>

#include "iota_shell.h"
#if defined(CONFIG_APP_WIFI_AUTO)
#include <net/wifi_mgmt.h>
#include "wifi.h"
#elif defined(CONFIG_NET_DHCPV4)
#include <net/net_event.h>
#include <net/net_if.h>
#endif

struct net_mgmt_event_callback net_event_cb;
static bool wallet_created = false;

#if defined(CONFIG_APP_WIFI_AUTO)
static void on_wifi_event(struct net_mgmt_event_callback *cb, uint32_t mgmt_event, struct net_if *iface) {
  const struct wifi_status *status = (const struct wifi_status *)cb->info;
  if (!wallet_created && status->status == 0) {
    if (init_wallet() == 0) {
      wallet_created = true;
    }
  }
}
#elif defined(CONFIG_NET_DHCPV4)
static void on_dhcp_event(struct net_mgmt_event_callback *cb, uint32_t mgmt_event, struct net_if *iface) {
  if (mgmt_event == NET_EVENT_IPV4_ADDR_ADD) {
    if (!wallet_created) {
      if (init_wallet() == 0) {
        wallet_created = true;
      }
    }
  }
}
#endif

void main(void) {
  printf("Hello %s\n", CONFIG_BOARD);

#if defined(CONFIG_APP_WIFI_AUTO)
  // wait for network event
  net_mgmt_init_event_callback(&net_event_cb, on_wifi_event, NET_EVENT_WIFI_CONNECT_RESULT);
  net_mgmt_add_event_callback(&net_event_cb);
  // wifi auto connect
  wifi_connect();
#elif defined(CONFIG_NET_DHCPV4)
  // wait for network event
  net_mgmt_init_event_callback(&net_event_cb, on_dhcp_event, (NET_EVENT_IPV4_ADDR_ADD | NET_EVENT_IPV4_ADDR_DEL));
  net_mgmt_add_event_callback(&net_event_cb);
  // enable dhcpv4 for eth
  struct net_if *iface;
  iface = net_if_get_default();
  net_dhcpv4_start(iface);
#endif
}
```

## src/ca_certificate.h
```c
// Copyright 2021 IOTA Stiftung
// SPDX-License-Identifier: Apache-2.0

#pragma once

#define CA_CERTIFICATE_TAG 1

// amazon root CA1
static const unsigned char ca_certificate[] = {
#include "app-cert.der.inc"
};
```

## src/iota_shell.c
```c
// Copyright 2021 IOTA Stiftung
// SPDX-License-Identifier: Apache-2.0

#include <logging/log.h>
LOG_MODULE_REGISTER(app, CONFIG_IOTA_APP_LOG_LEVEL);

#include <inttypes.h>
#include <shell/shell.h>
#include <stdio.h>
#include <zephyr.h>

#include <net/http_client.h>
#include <net/socket.h>

#include "client/api/v1/get_balance.h"
#include "client/api/v1/get_node_info.h"
#include "client/api/v1/send_message.h"
#include "client/network/http.h"
#include "wallet/bip39.h"
#include "wallet/wallet.h"

// IOTA wallet instance
static iota_wallet_t *w_ctx = NULL;

static int cmd_info(const struct shell *shell, size_t argc, char **argv) {
  ARG_UNUSED(argc);
  ARG_UNUSED(argv);

  res_node_info_t *info = res_node_info_new();
  if (get_node_info(&w_ctx->endpoint, info) == 0) {
    if (info->is_error == false) {
      // display node info on console
#ifdef CONFIG_NEWLIB_LIBC_FLOAT_PRINTF
      printf(
          "Name: %s\nVersion: %s\nNetwork ID: %s\nBech32HRP: %s\nMessage Pre Sec: %.2f\nisHealthy: %s\nLatest "
          "Milestone Index: %" PRIu64 "\nConfirmed Milestone Index: %" PRIu64 "\nPruning Milestone Index: %" PRIu64
          "\nLatest Milestone Timestamp: %" PRIu64 "\n",
          info->u.output_node_info->name, info->u.output_node_info->version, info->u.output_node_info->network_id,
          info->u.output_node_info->bech32hrp, info->u.output_node_info->msg_pre_sec,
          info->u.output_node_info->is_healthy ? "true" : "false", info->u.output_node_info->latest_milestone_index,
          info->u.output_node_info->confirmed_milestone_index, info->u.output_node_info->pruning_milestone_index,
          info->u.output_node_info->latest_milestone_timestamp);
#else
      printf(
          "Name: %s\nVersion: %s\nNetwork ID: %s\nBech32HRP: %s\nMessage Pre Sec: %.2f\nisHealthy: %s\nLatest "
          "Milestone Index: %" PRIu64 "\nConfirmed Milestone Index: %" PRIu64 "\nPruning Milestone Index: %" PRIu64
          "\nLatest Milestone Timestamp: %" PRIu64 "\n",
          info->u.output_node_info->name, info->u.output_node_info->version, info->u.output_node_info->network_id,
          info->u.output_node_info->bech32hrp, info->u.output_node_info->msg_pre_sec,
          info->u.output_node_info->is_healthy ? "true" : "false", info->u.output_node_info->latest_milestone_index,
          info->u.output_node_info->confirmed_milestone_index, info->u.output_node_info->pruning_milestone_index,
          info->u.output_node_info->latest_milestone_timestamp);
#endif
    } else {
      shell_print(shell, "Err: %s\n", info->u.error->msg);
    }
  } else {
    shell_print(shell, "API request failed\n");
  }

  res_node_info_free(info);
  return 0;
}

static int cmd_data(const struct shell *shell, size_t argc, char **argv) {
  res_send_message_t res = {};
  printf("Sending Index: \"%s\", Message: \"%s\"\n", argv[1], argv[2]);
  // send out text message
  int err = send_indexation_msg(&w_ctx->endpoint, argv[1], argv[2], &res);
  if (err) {
    if (res.is_error) {
      LOG_ERR("Err response: %s", res.u.error->msg);
      res_err_free(res.u.error);
    } else {
      LOG_ERR("send_indexation_msg failed (%d)", err);
    }
  } else {
    printf("message ID: %s\n", res.u.msg_id);
  }
  return 0;
}

static void dump_address(iota_wallet_t *w, uint32_t index, bool is_change) {
  char tmp_bech32_addr[65];
  byte_t tmp_addr[ED25519_ADDRESS_BYTES];

  wallet_bech32_from_index(w, is_change, index, tmp_bech32_addr);
  wallet_address_from_index(w, is_change, index, tmp_addr);

  printf("Addr[%" PRIu32 "]\n", index);
  // print ed25519 address without version filed.
  printf("\t");
  dump_hex_str(tmp_addr, ED25519_ADDRESS_BYTES);
  // print out
  printf("\t%s\n", tmp_bech32_addr);
}

static int cmd_addr(const struct shell *shell, size_t argc, char **argv) {
  bool change = (bool)argv[1];  // address type: 0 or 1
  long s = atol(argv[2]);       // starting index
  long n = atol(argv[3]);       // number of addresses
  if (s < 0 || n < 0) {
    shell_print(shell, "invalid index or numbers");
    return -1;
  }

  for (uint32_t idx = s; idx < s + n; idx++) {
    dump_address(w_ctx, idx, change);
  }
  return 0;
}

static int cmd_balance(const struct shell *shell, size_t argc, char **argv) {
  if (argc == 2) {
    // new API response object
    res_balance_t *res = res_balance_new();
    if (!res) {
      LOG_ERR("allocate balance object failed\n");
      return -1;
    }

    // an address hash
    if (strncmp(argv[1], w_ctx->bech32HRP, strlen(w_ctx->bech32HRP)) != 0) {
      shell_print(shell, "invalid address hash");
      res_balance_free(res);
      return -1;
    }

    if (get_balance(&w_ctx->endpoint, true, argv[1], res) != 0) {
      shell_print(shell, "get balance failed");
      res_balance_free(res);
      return -1;
    }

    if (res->is_error) {
      // got an error from node
      LOG_ERR("Node: %s\n", res->u.error->msg);
    }

    shell_print(shell, "balance: %" PRIu64 "", res->u.output_balance->balance);
    // clean up
    res_balance_free(res);
  } else {
    uint64_t value = 0;
    bool change = (bool)argv[1];  // address type: 0 or 1
    long s = atol(argv[2]);       // starting index
    long n = atol(argv[3]);       // number of addresses
    if (s < 0 || n < 0) {
      shell_print(shell, "invalid index or numbers");
      return -1;
    }

    for (uint32_t idx = s; idx < s + n; idx++) {
      if (wallet_balance_by_index(w_ctx, change, idx, &value) != 0) {
        LOG_ERR("wallet get balance [%" PRIu32 "]failed\n", idx);
        break;
      }
      dump_address(w_ctx, idx, change);
      printf("balance: %" PRIu64 "\n", value);
    }
  }
  return 0;
}

static int cmd_send(const struct shell *shell, size_t argc, char **argv) {
  char msg_id[IOTA_MESSAGE_ID_HEX_BYTES + 1] = {};
  char const data[] = "sent from iota.c";
  byte_t recv_addr[IOTA_ADDRESS_BYTES] = {};
  long addr_index = atol(argv[1]);      // address index
  char *bech32_addr = (char *)argv[2];  // receiver address in bech32 format
  long value = atol(argv[3]);           // tokens

  if (addr_index < 0 || value <= 0) {
    shell_print(shell, "invalid index or token value");
    return -1;
  }

  if (strncmp(bech32_addr, w_ctx->bech32HRP, strlen(w_ctx->bech32HRP)) != 0) {
    shell_print(shell, "invalid address hash");
    return -1;
  }

  if (strlen(bech32_addr) != IOTA_ADDRESS_HEX_BYTES) {
    shell_print(shell, "invalid address length");
    return -1;
  }

  if (address_from_bech32(w_ctx->bech32HRP, bech32_addr, recv_addr) != 0) {
    shell_print(shell, "convert address to binary failed");
    return -1;
  }

  shell_print(shell, "Sending %ld Mi to %s", value, bech32_addr);
  value = value * 1000000;  // Mi

  // send from address that change is 0
  int err = wallet_send(w_ctx, false, (uint32_t)addr_index, recv_addr + 1, value, "ZephyrWallet", (byte_t *)data,
                        sizeof(data), msg_id, sizeof(msg_id));
  if (err) {
    shell_print(shell, "send transaction failed");
    return -1;
  }

  shell_print(shell, "Message HASH: %s", msg_id);
  return 0;
}

/* Creating subcommands (level 1 command) array for command "iota". */
SHELL_STATIC_SUBCMD_SET_CREATE(sub_iota, SHELL_CMD(info, NULL, "Display node info", cmd_info),
                               SHELL_CMD_ARG(data, NULL,
                                             "Send data message.\n "
                                             "\tEx: iota data \"my ID\" \"hello iota\"",
                                             cmd_data, 3, 0),
                               SHELL_CMD_ARG(addr, NULL,
                                             "Get addresses from a given range.\n "
                                             "\tiota addr [is_change] [start_index] [count]\n "
                                             "\tEx: iota addr 0 0 5",
                                             cmd_addr, 4, 0),
                               SHELL_CMD_ARG(balance, NULL,
                                             "Get balance from an address or a given range.\n "
                                             "\tiota balance [is_change] [start_index] [count]\n "
                                             "\tiota balance [bech32_address]\n "
                                             "\tEx: iota balance 0 0 5\n "
                                             "\tiota balance atoi1qzdglt68p...xtav6e82tp",
                                             cmd_balance, 2, 2),
                               SHELL_CMD_ARG(send, NULL,
                                             "send value transaction to an address\n "
                                             "\tiota send [addr_index] [recv_bech32_addr] [amount]\n "
                                             "\tEx: iota send 0 atoi1qzdglt68p...xtav6e82tp 3",
                                             cmd_send, 4, 0),
                               SHELL_SUBCMD_SET_END);
/* Creating root (level 0) command "iota" without a handler */
SHELL_CMD_REGISTER(iota, &sub_iota, "IOTA client demo commands", NULL);

static int init_http_client_conf(iota_wallet_t *w) {
  char const *const http_prefix = "http://";
  char const *const tls_prefix = "https://";
  char const *const url = CONFIG_IOTA_NODE_URL;

  if (strncmp(url, http_prefix, strlen(http_prefix)) == 0) {
    size_t s = strlen(http_prefix);
    size_t len = strlen(url) - s;
    if (len > sizeof(w->endpoint.host)) {
      LOG_ERR("hostname: %s is too long", url + s);
      return -1;
    }

    memcpy(w->endpoint.host, url + s, len);
    w->endpoint.host[len] = '\0';

    w->endpoint.use_tls = false;
  } else if (strncmp(url, tls_prefix, strlen(tls_prefix)) == 0) {
    size_t s = strlen(tls_prefix);
    size_t len = strlen(url) - s;
    if (len > sizeof(w->endpoint.host)) {
      LOG_ERR("hostname: %s is too long", url + s);
      return -1;
    }

    memcpy(w->endpoint.host, url + s, len);
    w->endpoint.host[len] = '\0';

    w->endpoint.use_tls = true;
  } else {
    LOG_ERR("Err: Invalid URL format: %s", url);
    return -1;
  }
  w->endpoint.port = CONFIG_IOTA_NODE_PORT;
  LOG_INF("Node: %s%s:%d", w->endpoint.use_tls ? tls_prefix : http_prefix, w->endpoint.host, w->endpoint.port);
  return 0;
}

int init_wallet() {
  // buffer holds ramdom mnemonic sentence
  char ms_buf[256] = {};
  LOG_DBG(" ");

  // validating seed config
  if (strcmp(CONFIG_WALLET_MNEMONIC, "RANDOM") == 0) {
    printf("Generating new mnemonic sentence...\n");
    mnemonic_generator(MS_ENTROPY_256, MS_LAN_EN, ms_buf, sizeof(ms_buf));
    printf("###\n%s\n###\n", ms_buf);
    // init wallet with account index 0
    if ((w_ctx = wallet_create(ms_buf, "", 0)) == NULL) {
      LOG_ERR("create wallet failed with random mnemonic");
      return -1;
    }
  } else {
    if ((w_ctx = wallet_create(CONFIG_WALLET_MNEMONIC, "", 0)) == NULL) {
      LOG_ERR("create wallet failed with default mnemonic");
      return -1;
    }
  }

  // http client setup
  if (init_http_client_conf(w_ctx) != 0) {
    LOG_ERR("http client configuration failed");
    wallet_destroy(w_ctx);
    return -1;
  }

  if (wallet_update_bech32HRP(w_ctx) != 0) {
    LOG_ERR("update bech32HRP failed");
    wallet_destroy(w_ctx);
    return -1;
  }

  printf("wallet initialized...OK\n");
  return 0;
}
```

## src/iota_shell.h
```c
// Copyright 2021 IOTA Stiftung
// SPDX-License-Identifier: Apache-2.0

#pragma once

int init_wallet();
```

## src/wifi.c
```c
// Copyright 2021 IOTA Stiftung
// SPDX-License-Identifier: Apache-2.0

#ifdef CONFIG_APP_WIFI_AUTO

#include <logging/log.h>
LOG_MODULE_REGISTER(app_wifi, CONFIG_APP_WIFI_CONN_LOG_LEVEL);

#include <net/wifi_mgmt.h>

static int connected;
static struct net_mgmt_event_callback wifi_shell_mgmt_cb;

static void handle_wifi_connect_result(struct net_mgmt_event_callback *cb) {
  const struct wifi_status *status = (const struct wifi_status *)cb->info;

  if (status->status) {
    LOG_ERR("Connection request failed (%d)", status->status);
  } else {
    LOG_INF("WIFI Connected");
    connected = 1;
  }
}

static void wifi_mgmt_event_handler(struct net_mgmt_event_callback *cb, uint32_t mgmt_event, struct net_if *iface) {
  switch (mgmt_event) {
    case NET_EVENT_WIFI_CONNECT_RESULT:
      handle_wifi_connect_result(cb);
      break;
    default:
      break;
  }
}

void wifi_connect(void) {
  int nr_tries = 10;
  int ret = 0;

  net_mgmt_init_event_callback(&wifi_shell_mgmt_cb, wifi_mgmt_event_handler, NET_EVENT_WIFI_CONNECT_RESULT);

  net_mgmt_add_event_callback(&wifi_shell_mgmt_cb);

  struct net_if *iface = net_if_get_default();
  static struct wifi_connect_req_params cnx_params = {
      .ssid = CONFIG_APP_WIFI_SSID,
      .ssid_length = 0,
      .psk = CONFIG_APP_WIFI_PWD,
      .psk_length = 0,
      .channel = 0,
      .security = WIFI_SECURITY_TYPE_PSK,
  };

  cnx_params.ssid_length = strlen(CONFIG_APP_WIFI_SSID);
  cnx_params.psk_length = strlen(CONFIG_APP_WIFI_PWD);

  connected = 0;

  LOG_INF("WIFI try connecting to %s...", CONFIG_APP_WIFI_SSID);

  /* Let's wait few seconds to allow wifi device be on-line */
  while (nr_tries-- > 0) {
    ret = net_mgmt(NET_REQUEST_WIFI_CONNECT, iface, &cnx_params, sizeof(struct wifi_connect_req_params));
    if (ret == 0) {
      break;
    }

    LOG_INF("Connect request failed %d. Waiting iface be up...", ret);
    k_msleep(500);
  }

  while (connected == 0) {
    k_msleep(100);
  }
}

#endif
```

## src/wifi.h
```c
// Copyright 2021 IOTA Stiftung
// SPDX-License-Identifier: Apache-2.0

/**
 * @brief connect to wifi
 *
 */
void wifi_connect(void);
```
